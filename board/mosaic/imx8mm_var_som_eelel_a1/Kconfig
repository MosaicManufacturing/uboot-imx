## board/mosaic/imx8mm_var_som_eelel_a1/Kconfig
```kconfig
if TARGET_IMX8MM_VAR_SOM_EELEL_A1

config SYS_BOARD
	default "imx8mm_var_som_eelel_a1"

config SYS_VENDOR
	default "mosaic"

config SYS_CONFIG_NAME
	default "imx8mm_var_som_eelel_a1"

source "board/freescale/common/Kconfig"

endif
```

## board/variscite/imx8mm_var_dart/Kconfig
```kconfig
if TARGET_IMX8MM_VAR_DART

config SYS_BOARD
	default "imx8mm_var_dart"

config SYS_VENDOR
	default "variscite"

config SYS_CONFIG_NAME
	default "imx8mm_var_dart"

source "board/freescale/common/Kconfig"

endif

if TARGET_IMX8MM_VAR_SOM_EELEL_000_MAIN_PCB_A1

config SYS_BOARD
	default "imx8mm_var_som_EELEL_000_MAIN_PCB_A1"

config SYS_VENDOR
	default "variscite"

config SYS_CONFIG_NAME
	default "imx8mm_var_som_EELEL_000_MAIN_PCB_A1"

source "board/freescale/common/Kconfig"

endif
```
